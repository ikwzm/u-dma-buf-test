/dts-v1/; /plugin/;
/ {
	fragment@0 {
		target-path = "/amba_pl@0";
		#address-cells = <2>;
		#size-cells = <2>;

		__overlay__ {
			#address-cells = <2>;
			#size-cells = <2>;

			udmabuf0 {
				compatible  = "ikwzm,u-dma-buf";
				device-name = "udmabuf0";
				size = <0x02000000>;
				dma-coherent;
			};
                };
	} ;
} ;
